## Implementation/ECM3532/Applications/111NewProj_notwork/Kconfig
```kconfig
menu "Hello World"
comment "Hello world test app, simple task periodically prints hello on uart"
config APP_LED_GPIO
  int "LED GPIO"
  default 1
orsource Kernel_config
endmenu
orsource Kernel_config
```

## Implementation/ECM3532/Applications/SZC_motion_B_s3/Kconfig
```kconfig
menu "Compiler tool demo"
comment "Test the output infer.c from compiler"



orsource "Kernel_config"

endmenu
```
